## idf/sdkconfig.defaults
```kconfig
CONFIG_ESPTOOLPY_FLASHMODE_QIO=y
CONFIG_ESPTOOLPY_FLASHFREQ_80M=y
CONFIG_ESPTOOLPY_FLASHSIZE_8MB=y
CONFIG_ESP_MAIN_TASK_STACK_SIZE=8192
CONFIG_ESP_CONSOLE_USB_SERIAL_JTAG=y
CONFIG_ESP_CONSOLE_UART_DEFAULT=n
CONFIG_TINYUSB_ENABLED=y
CONFIG_TINYUSB_CDC_ENABLED=y
CONFIG_TINYUSB_CDC_COUNT=2
CONFIG_TINYUSB_DESC_MANUFACTURER_STRING="IU3QEZ"
CONFIG_TINYUSB_DESC_PRODUCT_STRING="IU3QEZ Dual CDC"
CONFIG_TINYUSB_DESC_SERIAL_STRING="0001"
CONFIG_TINYUSB_DESC_CDC_STRING="Keyer CDC"
```
